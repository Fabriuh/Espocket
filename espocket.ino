/////////// LIBRERIAS ////////////////
#include <Adafruit_GFX.h>
#include <Adafruit_SSD1306.h>
#include <Wire.h>
#include <RTClib.h>
#include <EEPROM.h>
/////////////////////////////////////
////////// CONSTANTES /////////////
#define SCREEN_WIDTH 128
#define SCREEN_HEIGHT 64
#define OLED_RESET    -1
#define SDA_PIN 8
#define SCL_PIN 9
#define DOWNBUTTON 10
#define MIDBUTTON 20
#define UPBUTTON 21
#define BUZZER_PIN 3
#define MAX_FISH 3
#define MAX_FOOD 5
#define MAX_BUBBLES 10
///////////////////////////////////
///////// DEFINICION DE PANTALLA/////////////
Adafruit_SSD1306 display(SCREEN_WIDTH, SCREEN_HEIGHT, &Wire, OLED_RESET);
///////// DEFINICIOIN DE RTC ///////////////
RTC_DS3231 rtc;
//////////// VARIABLES PARA EL MENU///////////////
// --- Config del carrusel ---
const int posX[3] = {40, 64, 88};   // posiciones base: izquierda, centro, derecha
const int centerY = 32;
const int spacing = (88 - 64);      // distancia entre posiciones (24 px)
const int rSide = 5;
const int rCenter = 8;

const char* itemNames[5] = {"pecera", "pong", "GIF", "reloj", "alarma"};
const int numItems = sizeof(itemNames) / sizeof(itemNames[0]);
// Estado del carrusel
int selectedIndex = 0;              // ítem actualmente en el centro (0..2)
float slideOffset = 0;              // desplazamiento X en píxeles ([-spacing, spacing])
int slideDir = 0;                   // -1 = hacia prev (contenido se mueve a la derecha), +1 = hacia next (contenido a la izquierda)
bool isSliding = false;

// Animación “flotar” del centro
float floatOff = 0;
bool floatUp = true;
volatile bool mediopresionado = false;
volatile int menu = 1;
/////////////////// VARIABLES GIF/////////////
#define FRAME_WIDTH (64)
#define FRAME_HEIGHT (64)
#define FRAME_COUNT (sizeof(frames) / sizeof(frames[0]))
int FRAME_DELAY = 22 ;
int frame = 0;
const byte PROGMEM frames[][512] = {
  {0,0,0,0,0,0,0,0,0,0,0,0,0,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0,0},
  {0,0,0,0,0,0,0,0,0,0,0,0,0,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0,0},
  {0,0,0,0,0,0,0,0,0,0,0,0,0,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0,0},
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  {0,0,0,0,0,0,0,0,0,0,0,0,0,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0,0}
};
/////////////////////////////////////////////
//////////////////// VARIABLES ALARMA /////////////////
// Variables para editor de hora
int digitoH1 = 0, digitoH2 = 0, digitoM1 = 0, digitoM2 = 0;
int indiceSeleccionado = 0;

// Variables de alarma
int alarmaHora = -1;
int alarmaMin = -1;
bool alarmaActiva = false;
bool alarmaSonando = false;

// EEPROM
#define EEPROM_ADDR 0

/////////////////////////////////
////////////// VARIABLES PARA PONG //////////////////
const int PADDLE_W = 3;
const int PADDLE_H = 15;
const int BALL_R   = 2;
const int GOAL_SCORE = 15;
const int dificultadpong = 1;

int nikoY;
float cpuY;
int ballX, ballY;
int ballSpeedX, ballSpeedY;
int nikoScore = 0;
int cpuScore  = 0;

enum GameState { PLAYING, VICTORY, DEFEAT };
GameState state = PLAYING;
///////////////////////////////////////////////////////
////////////////////////////////////////////////////////////////////// CODIGO PECES //////////////////////////////////////////////////////////////////////////
//////// PESCADO /////////
int fishTargetFood[MAX_FISH]; // objetivo de comida para cada pez
struct Fish {
  int x, y;
  int size;
  int speed;
  bool direction; // true: derecha, false: izquierda
  int eaten;
  int targetFood;   // índice de la comida que persigue
};
//////// COMIDA //////////
struct Food {
  int x, y;
  bool active;
};
//////// BURBUJAS ////////
struct Bubble {
  int x, y;
  int speed;
};

Fish fishes[MAX_FISH];
Food foods[MAX_FOOD];
Bubble bubbles[MAX_BUBBLES];

/////////////// DIBUJAR PESCADOS /////////////////////
void drawFish(Fish &fish) {
  int s = fish.size;
  int x = fish.x;
  int y = fish.y;

  if (fish.direction) {
    display.fillCircle(x, y, s, WHITE);
    display.fillTriangle(x - s, y, x - s - 3, y - 2, x - s - 3, y + 2, WHITE);
    display.drawPixel(x + 1, y - 1, BLACK);
    // Derecha
  } else {
    // Izquierda
    display.fillCircle(x, y, s, WHITE);
    display.fillTriangle(x + s, y, x + s + 3, y - 2, x + s + 3, y + 2, WHITE);
    display.drawPixel(x - 1, y - 1, BLACK);
  }
}
///////////// DIBUJAR COMIDA //////////////////
void drawFood(Food &food) {
  if (food.active) {
    display.fillCircle(food.x, food.y, 3, WHITE);
  }
}

///////////// DIBUJAR BURBUJAS ///////////////
void drawBubble(Bubble &b) {
  display.drawCircle(b.x, b.y, 2, WHITE);
}
///////////// DIBUJAR BORDES ////////////////
void drawDoubleBorder() {
  display.drawRect(0, 0, SCREEN_WIDTH, SCREEN_HEIGHT, WHITE);
  display.drawRect(2, 2, SCREEN_WIDTH - 4, SCREEN_HEIGHT - 4, WHITE);
}
/////////////// DIBUJAR PLANTAS /////////////
void drawPlants() {
  // Planta 1 - curva
  for (int i = 0; i < 5; i++) {
    display.drawLine(10 + i, 63, 10 + i - (i % 2 == 0 ? 2 : -2), 50 - i * 2, WHITE);
  }

  // Planta 2 - más alta
  for (int i = 0; i < 6; i++) {
    display.drawLine(30 + i, 63, 30 + i + (i % 2 == 0 ? 1 : -1), 47 - i * 2, WHITE);
  }

  // Planta 3 - más ancha
  for (int i = 0; i < 7; i++) {
    display.drawLine(60 + i, 63, 60 + i + (i % 2 == 0 ? 2 : -1), 45 - i * 2, WHITE);
  }

  // Planta 4 - más recta
  for (int i = 0; i < 4; i++) {
    display.drawLine(100 + i, 63, 100 + i, 48 - i * 3, WHITE);
  }
}
/////////////////////////////////////////////////////////////////////////////////////////////////////////////////////////////////////////////////////////////
////// INTERRUPCION POR HARDWARE DE MENUS ///////////////////
void IRAM_ATTR mediopresionadoo() {
  static unsigned long lastInterruptTime = 0;
  unsigned long interruptTime = millis();
  if(interruptTime - lastInterruptTime>200){
  mediopresionado = true;
  lastInterruptTime = interruptTime;
  }
}
//////// MENU PRINCIPAL ////////////////////////
void menuprincipal (){
  if (floatUp) floatOff += 0.20;
  else         floatOff -= 0.20;
  if (floatOff > 3)  floatUp = false;
  if (floatOff < -3) floatUp = true;

  // --------- animación de desplazamiento ---------
  if (isSliding) {
    const float speed = 3.2; // px/frame
    // Convención: slideDir = +1 (NEXT) => contenido se mueve a la izquierda
    slideOffset += (slideDir > 0 ? -speed : +speed);

    if (slideOffset <= -spacing) {
      // terminó un paso hacia NEXT
      selectedIndex = idxRight(selectedIndex);
      slideOffset += spacing; // normaliza a 0
      isSliding = false;
    } else if (slideOffset >= spacing) {
      // terminó un paso hacia PREV
      selectedIndex = idxLeft(selectedIndex);
      slideOffset -= spacing; // normaliza a 0
      isSliding = false;
    }
  }

  // --------- dibujar ---------
  display.clearDisplay();

  // Índices visibles relativo al seleccionado SIEMPRE en el centro
  int iL = idxLeft(selectedIndex);
  int iC = selectedIndex;
  int iR = idxRight(selectedIndex);

// Izquierda
  drawCircleAt(posX[0] + slideOffset, centerY, rSide, false);
// Centro
  drawCircleAt(posX[1] + slideOffset, centerY + floatOff, rCenter, true);
// Derecha
  drawCircleAt(posX[2] + slideOffset, centerY, rSide, false); 

  display.setTextSize(1);
  display.setTextColor(SSD1306_WHITE);
  display.setCursor((SCREEN_WIDTH - strlen(itemNames[iC]) * 6) / 2, 54); // centrado
  display.print(itemNames[iC]);

  display.display();
  delay(30);


}
void drawCircleAt(int x, int y, int r, bool isCenter) {
  display.fillCircle(x, y, r, SSD1306_WHITE);
  if (isCenter) display.drawCircle(x, y, r + 2, SSD1306_WHITE);
}

// --- Controles públicos (llamarlos desde tu boton) ---
void nextItem() {
  if (isSliding) return;
  slideDir = +1;       // mover contenido a la izquierda
  isSliding = true;
}

void prevItem() {
  if (isSliding) return;
  slideDir = -1;       // mover contenido a la derecha
  isSliding = true;
}
const char* getSelectedItem() { // llamar a esta funcion para saber el item seleccionado
  return itemNames[selectedIndex];
}
//
inline int idxLeft(int i)  { return (i + numItems - 1) % numItems; }
inline int idxRight(int i) { return (i + 1) % numItems; }
///////////////////////////////////////////////////////////////////////////////////////////////////
////////////////////////////////PONG////////////////////////////////////////////////
void resetBall() {
  ballX = SCREEN_WIDTH / 2;
  ballY = SCREEN_HEIGHT / 2;
  ballSpeedX = (random(0, 2) == 0) ? -2 : 2;
  ballSpeedY = (random(0, 2) == 0) ? -1 : 1;
}

void resetMatch() {
  nikoScore = 0;
  cpuScore  = 0;
  nikoY = (SCREEN_HEIGHT - PADDLE_H) / 2;
  cpuY  = (SCREEN_HEIGHT - PADDLE_H) / 2;
  resetBall();
  state = PLAYING;
}

void drawHUD() {
  display.setTextSize(1);
  display.setTextColor(SSD1306_WHITE);
  // Marcador arriba
  display.setCursor(2, 0);
  display.print("Niko: ");
  display.print(nikoScore);
  display.setCursor(80, 0);
  display.print("CPU: ");
  display.print(cpuScore);
}

void drawCenterNet() {
  for (int y = 5; y < SCREEN_HEIGHT; y += 6) {
    display.drawFastVLine(SCREEN_WIDTH/2, y, 3, SSD1306_WHITE);
  }
}

void pong(){
 // Pantallas de final (con marcador visible y reinicio con UP)
  if (state == VICTORY || state == DEFEAT) {
    display.clearDisplay();
    drawHUD();

    display.setTextSize(2);
    display.setTextColor(SSD1306_WHITE);
    display.setCursor(18, 20);
    if (state == VICTORY) display.println("VICTORIA");
    else                  display.println("DERROTA");

    display.setTextSize(1);
    display.setCursor(18, 40);
    display.println("Derecha para");
    display.setCursor(18, 50);
    display.println("reiniciar");
    display.display();

    if (digitalRead(UPBUTTON) == LOW) {
      // pequeño debounce
      delay(200);
      if (digitalRead(UPBUTTON) == LOW) {
        resetMatch();
      }
    }
    delay(10);
    return;
  }

  // ---- CONTROLES NIKO ----
  if (digitalRead(UPBUTTON) == LOW && nikoY > 0) {
    nikoY -= 2;
  }
  if (digitalRead(DOWNBUTTON) == LOW && nikoY < SCREEN_HEIGHT - PADDLE_H) {
    nikoY += 2;
  }

  // ---- IA CPU (simple) ----
  int cpuCenter = cpuY + PADDLE_H/2 + random(-5, 5);
  if(ballX > SCREEN_WIDTH/2){
  if (cpuCenter < ballY && cpuY < SCREEN_HEIGHT - PADDLE_H) cpuY += dificultadpong;
  if (cpuCenter > ballY && cpuY > 0)                        cpuY -= dificultadpong;
}
  // ---- FÍSICA PELOTA ----
  ballX += ballSpeedX;
  ballY += ballSpeedY;

  // Rebotes verticales (considerando el radio)
  if (ballY <= BALL_R) {
    ballY = BALL_R;
    ballSpeedY = -ballSpeedY;
  }
  if (ballY >= SCREEN_HEIGHT - 1 - BALL_R) {
    ballY = SCREEN_HEIGHT - 1 - BALL_R;
    ballSpeedY = -ballSpeedY;
  }

  // Colisión con paleta Niko (izquierda)
  if (ballX - BALL_R <= (2 + PADDLE_W) &&
      ballY >= nikoY && ballY <= nikoY + PADDLE_H) {
    tone(BUZZER_PIN, 1000, 200);  // 1000 Hz por 200 ms
    ballSpeedX = abs(ballSpeedX);        // hacia la derecha
    ballX = 2 + PADDLE_W + BALL_R;       // salir de la paleta
    // efecto según zona de impacto
    int hit = ballY - (nikoY + PADDLE_H/2);
    if (hit < 0) ballSpeedY = -abs(ballSpeedY);
    else         ballSpeedY =  abs(ballSpeedY);
    noTone(BUZZER_PIN);
  }

  // Colisión con paleta CPU (derecha)
  if (ballX + BALL_R >= (SCREEN_WIDTH - 2 - PADDLE_W) &&
      ballY >= cpuY && ballY <= cpuY + PADDLE_H) {
    tone(BUZZER_PIN, 1000, 200);  // 1000 Hz por 200 ms
    ballSpeedX = -abs(ballSpeedX);       // hacia la izquierda
    ballX = SCREEN_WIDTH - 2 - PADDLE_W - BALL_R;
    int hit = ballY - (cpuY + PADDLE_H/2);
    if (hit < 0) ballSpeedY = -abs(ballSpeedY);
    else         ballSpeedY =  abs(ballSpeedY);
    noTone(BUZZER_PIN);
  }

  // ---- PUNTO ----
  if (ballX < 0) {
    cpuScore++;
    resetBall();
  } else if (ballX > SCREEN_WIDTH) {
    nikoScore++;
    resetBall();
  }

  // ---- VICTORIA / DERROTA ----
  if (nikoScore >= GOAL_SCORE) {
    state = VICTORY;
  } else if (cpuScore >= GOAL_SCORE) {
    state = DEFEAT;
  }

  // ---- DIBUJO ----
  display.clearDisplay();

  drawHUD();
  drawCenterNet();

  // Paleta Niko (izquierda)
  display.fillRect(2, nikoY, PADDLE_W, PADDLE_H, SSD1306_WHITE);
  // Paleta CPU (derecha)
  display.fillRect(SCREEN_WIDTH - 2 - PADDLE_W, cpuY, PADDLE_W, PADDLE_H, SSD1306_WHITE);

  // Pelota
  display.fillCircle(ballX, ballY, BALL_R, SSD1306_WHITE);

  display.display();

  delay(16); // ~60 FPS
}
////////////////////////////////////////////////////////////////////////////
///////////////////////// GIF/////////////////////////////////
void GIF(){
  display.clearDisplay();
  display.drawBitmap(32, 0, frames[frame], FRAME_WIDTH, FRAME_HEIGHT, 1);
  display.display();
  frame = (frame + 1) % FRAME_COUNT;
  delay(FRAME_DELAY);
}
///////////////////////// RELOJ /////////////////////////////////
void reloj(){
  DateTime now = rtc.now();

  // Crear string de la hora en formato HH:MM:SS
  char buffer[9];
  sprintf(buffer, "%02d:%02d:%02d", now.hour(), now.minute(), now.second());

  display.clearDisplay();
  display.setTextSize(2); // Tamaño de texto
  display.setTextColor(SSD1306_WHITE);

  // Calcular el ancho del texto
  int16_t x1, y1;
  uint16_t w, h;
  display.getTextBounds(buffer, 0, 0, &x1, &y1, &w, &h);

  // Calcular posición centrada
  int x = (SCREEN_WIDTH - w) / 2;
  int y = (SCREEN_HEIGHT - h) / 2;

  // Dibujar hora en el centro
  display.setCursor(x, y);
  display.print(buffer);

  display.display();
  delay(250);
}
//////////////////////////////////////////////////////////
////////////////////// Peces tambien////////
void assignFoodTargets() {
  bool foodTaken[MAX_FOOD] = {false};
  for (int i = 0; i < MAX_FISH; i++) {
    for (int f = 0; f < MAX_FOOD; f++) {
      if (!foodTaken[f]) {
        fishTargetFood[i] = f;
        foodTaken[f] = true;
        break;
      }
    }
  }
}
///////////////// ALARMA ////////////////////////////////
void dibujarHora(int resaltado) {
  display.setTextSize(2);
  display.setTextColor(SSD1306_WHITE);

  int x[4] = {20, 40, 80, 100};
  int y = 20;
  int valores[4] = {digitoH1, digitoH2, digitoM1, digitoM2};

  for (int i = 0; i < 4; i++) {
    if (i == resaltado) {
      display.fillRect(x[i]-2, y-2, 16, 20, SSD1306_WHITE);
      display.setTextColor(SSD1306_BLACK, SSD1306_WHITE);
    } else {
      display.setTextColor(SSD1306_WHITE);
    }
    display.setCursor(x[i], y);
    display.print(valores[i]);
  }
  display.setTextColor(SSD1306_WHITE);
  display.setCursor(60, y);
  display.print(":");
}

// === ANIMAR CAMBIO DE DIGITO ===
void animarDigito(int &digito, int nuevo, int x, int y) {
  int offset = 0;
  int paso = 4;
  while (offset < 16) {
    display.clearDisplay();

    // Mostrar dígito actual bajando
    display.setTextSize(2);
    display.setCursor(x, y - offset);
    display.print(digito);

    // Mostrar nuevo dígito subiendo
    display.setCursor(x, y + (16 - offset));
    display.print(nuevo);

    // Dibujar otros dígitos
    dibujarHora(indiceSeleccionado);

    display.display();
    offset += paso;
    delay(30);
  }
  digito = nuevo;
}

// === CAMBIAR DIGITO SEGÚN REGLAS DEL RELOJ ===
void cambiarDigito(int indice) {
  int nuevo;
  switch (indice) {
    case 0: nuevo = (digitoH1 + 1) % 3; break; // H1: 0-2
    case 1: // H2
      nuevo = digitoH2 + 1;
      if (digitoH1 == 2 && nuevo > 3) nuevo = 0;
      else if (digitoH1 < 2 && nuevo > 9) nuevo = 0;
      break;
    case 2: nuevo = (digitoM1 + 1) % 6; break; // M1: 0-5
    case 3: nuevo = (digitoM2 + 1) % 10; break; // M2: 0-9
  }
  int x[4] = {20, 40, 80, 100};
  animarDigito(
    (indice == 0 ? digitoH1 : indice == 1 ? digitoH2 : indice == 2 ? digitoM1 : digitoM2),
    nuevo, x[indice], 20
  );
}
void alarma (){
  DateTime now = rtc.now();
  // Leer botones
  bool sel = (digitalRead(DOWNBUTTON) == LOW);
  bool chg = (digitalRead(UPBUTTON) == LOW);

  // Confirmar alarma si se presionan ambos botones
  if (sel && chg) {
    alarmaHora = digitoH1 * 10 + digitoH2;
    alarmaMin  = digitoM1 * 10 + digitoM2;

    EEPROM.write(EEPROM_ADDR, alarmaHora);
    EEPROM.write(EEPROM_ADDR+1, alarmaMin);
    EEPROM.commit();

    display.clearDisplay();
    display.setTextSize(1);
    display.setCursor(0,0);
    display.print("Alarma confirmada:");
    display.setCursor(0,20);
    display.setTextSize(2);
    display.printf("%02d:%02d", alarmaHora, alarmaMin);
    display.display();
    delay(1000);
  }
  else if (sel) { // cambiar dígito seleccionado
    indiceSeleccionado = (indiceSeleccionado + 1) % 4;
    delay(250);
  }
  else if (chg) { // cambiar valor del dígito
    cambiarDigito(indiceSeleccionado);
    delay(250);
  }
  // Mostrar reloj actual + hora de alarma + editor
  display.clearDisplay();
  display.setTextSize(2);
  display.setCursor(10,0);
  display.printf("%02d:%02d:%02d", now.hour(), now.minute(), now.second());

  display.setTextSize(1);
  display.setCursor(0,50);
  display.print("Alarma: ");
  if (alarmaHora >= 0)
    display.printf("%02d:%02d", alarmaHora, alarmaMin);
  else
    display.print("--:--");

  // Dibujar hora editable
  dibujarHora(indiceSeleccionado);

  display.display();
  delay(200);  
}
void alarmaactiva() {
  if (alarmaSonando) {
    display.clearDisplay();
    display.setTextSize(2);
    display.setCursor(15, 20);
    display.println("ALARMA!!!");
    display.display();
    tone(BUZZER_PIN, 1000, 200);  // 1000 Hz por 200 ms
    delay(250);
    tone(BUZZER_PIN, 1500, 200);  // 1500 Hz por 200 ms
    delay(250);
    tone(BUZZER_PIN, 1200, 200);  // 1200 Hz por 200 ms
    delay(250);

    if (digitalRead(UPBUTTON) == LOW || digitalRead(DOWNBUTTON) == LOW) {
      noTone(BUZZER_PIN);
      alarmaSonando = false;
      alarmaActiva = false;
      delay(500);
    }
    return;
  }
}
///////////////////////////////// SETUP //////////////////////////////////////
void setup() {
  pinMode(MIDBUTTON, INPUT_PULLUP);
  pinMode(UPBUTTON, INPUT_PULLUP);
  pinMode(DOWNBUTTON, INPUT_PULLUP);
  attachInterrupt(digitalPinToInterrupt(MIDBUTTON), mediopresionadoo, FALLING);
  Wire.begin(SDA_PIN, SCL_PIN);
 
  if (!display.begin(SSD1306_SWITCHCAPVCC, 0x3C)) {
    while (true);
  }
  if (!rtc.begin()) {
    display.clearDisplay();
    display.setCursor(0,0);
    display.println("Error RTC!");
    display.display();
    while (1);
  }
  if (rtc.lostPower()) {
    rtc.adjust(DateTime(F(__DATE__), F(__TIME__)));
  }
  display.clearDisplay();
  display.display();

  randomSeed(analogRead(A0));
  resetMatch();

for (int i = 0; i < MAX_FISH; i++) {
  fishes[i] = { 
    random(20, SCREEN_WIDTH - 20),   // x
    random(20, SCREEN_HEIGHT - 20),  // y
    3,                               // size
    random(2, 3),                    // speed
    random(0, 2),                    // direction (0/1)
    0,                               // eaten
    -1                               // targetFood  <-- NUEVO
  };
}

  for (int i = 0; i < MAX_FOOD; i++) {
    foods[i].active = false;
  }

  for (int i = 0; i < MAX_BUBBLES; i++) {
    bubbles[i] = {random(5, SCREEN_WIDTH - 5), random(10, SCREEN_HEIGHT), random(1, 2)};
  }
  EEPROM.begin(10);
  // Recuperar alarma guardada
  alarmaHora = EEPROM.read(EEPROM_ADDR);
  alarmaMin  = EEPROM.read(EEPROM_ADDR+1);
  if (alarmaHora >= 0 && alarmaHora < 24 && alarmaMin >= 0 && alarmaMin < 60) {
    digitoH1 = alarmaHora / 10;
    digitoH2 = alarmaHora % 10;
    digitoM1 = alarmaMin / 10;
    digitoM2 = alarmaMin % 10;
  } else {
    alarmaHora = -1;
    alarmaMin = -1;
  }

selectedIndex = 3;
menu = 0;
}
////////////////////////////////////////////////////////////////////////////////
/////////////////////////////////// LOOP //////////////////////////////////////
void loop(){
  DateTime now = rtc.now();
/////////////////////// chequeo de alarma ////////////////////////////
  if (alarmaHora == now.hour() && alarmaMin == now.minute() && now.second() == 0) {
    alarmaActiva = true;
    alarmaSonando = true;
    menu = 0;
  }
//////////////////
  String item = getSelectedItem();
  if (mediopresionado){
    mediopresionado = false;
   menu++;
   if (menu>1){
    String item = getSelectedItem();
     menu = 0;
  }
  }
  display.clearDisplay();
  if (menu == 1){
    menuprincipal();
  if (digitalRead(DOWNBUTTON) == LOW){
    prevItem();
  }
  if (digitalRead(UPBUTTON) == LOW){
    nextItem();
  }
  }
  if ((menu == 0)&&(item == "pecera")&&(alarmaSonando==false)){ // SI MENU NO ESTÁ SELECCIONADO Y ESTÁ SELECCIONADO PECERA
  // Doble borde
  drawDoubleBorder();

  // Plantas variadas
  drawPlants();

  // Burbujas
  for (int i = 0; i < MAX_BUBBLES; i++) {
    drawBubble(bubbles[i]);
    bubbles[i].y -= bubbles[i].speed;
    if (bubbles[i].y < 5) {
      bubbles[i].y = SCREEN_HEIGHT - 1;
      bubbles[i].x = random(5, SCREEN_WIDTH - 5);
    }
  }

  // Alimentos
  for (int i = 0; i < MAX_FOOD; i++) {
    if (foods[i].active) {
      foods[i].y += 1;
      if (foods[i].y >= SCREEN_HEIGHT - 1) foods[i].active = false;
      drawFood(foods[i]);
    }
  }

  // Peces
// Peces
for (int i = 0; i < MAX_FISH; i++) {
  Fish &f = fishes[i];

  // ----------- ASIGNACIÓN / RE-ASIGNACIÓN DE COMIDA EXCLUSIVA -----------
  if (f.targetFood < 0 || !foods[f.targetFood].active) {
    f.targetFood = -1;
    for (int j = 0; j < MAX_FOOD; j++) {
      if (!foods[j].active) continue;

      // ¿ya la persigue otro pez?
      bool taken = false;
      for (int k = 0; k < MAX_FISH; k++) {
        if (k != i && fishes[k].targetFood == j) { taken = true; break; }
      }
      if (!taken) { f.targetFood = j; break; }
    }
  }

  // ----------- MOVERSE Y COMER COMIDA -----------
  if (f.targetFood >= 0 && foods[f.targetFood].active) {
    int j = f.targetFood;
    int dx = foods[j].x - f.x;
    int dy = foods[j].y - f.y;

    if (abs(dx) < 3 && abs(dy) < 3) {
      // Comer
      foods[j].active = false;
      f.eaten++;
      if (f.eaten >= 3) { f.size++; f.eaten = 0; }
      f.targetFood = -1; // libera objetivo
    } else {
      f.direction = dx > 0;
      f.x += (dx > 0 ? 1 : -1) * f.speed;
      f.y += (dy > 0 ? 1 : -1) * (f.speed / 2);
    }
  }

  // ----------- DEPREDACIÓN ENTRE PECES (f grande se come a otro) -----------
  for (int j = 0; j < MAX_FISH; j++) {
    if (i == j) continue;
    Fish &other = fishes[j];

    if (f.size > other.size + 2 &&
        abs(f.x - other.x) < 5 &&
        abs(f.y - other.y) < 5) {
      // f se come a other
      f.size++;
      other.x = random(10, SCREEN_WIDTH - 10);
      other.y = random(10, SCREEN_HEIGHT - 10);
      other.size = 2;
      other.eaten = 0;
      other.targetFood = -1;
    }
  }

  // ----------- AJUSTES Y MOVIMIENTO BASAL (sólo si no tiene comida asignada) -----------
  if (f.size > 8) f.size = 8;

  if (f.targetFood < 0) { // “nado libre” si no tiene objetivo
    if (random(100) < 5)  f.direction = !f.direction;
    if (random(100) < 10) f.y += random(-1, 2);

    if (f.direction) f.x += f.speed;
    else             f.x -= f.speed;
  }

  // Límites
  if (f.x < 5) { f.direction = true;  f.x = 5; }
  if (f.x > SCREEN_WIDTH - 5) { f.direction = false; f.x = SCREEN_WIDTH - 5; }
  if (f.y < 10) f.y = 10;
  if (f.y > SCREEN_HEIGHT - 10) f.y = SCREEN_HEIGHT - 10;

  // Dibujo
  drawFish(f);
} // <-- asegurate de que ESTA llave cierre el bucle de peces

  

  // Alimentar
  if (digitalRead(UPBUTTON) == LOW) {
    for (int i = 0; i < MAX_FOOD; i++) {
      if (!foods[i].active) {
        foods[i].x = random(10, SCREEN_WIDTH - 10);
        foods[i].y = 5;
        foods[i].active = true;
        assignFoodTargets();
        delay(200);
        break; // una por pulsación
      }
    }
  }

  display.display();
  delay(80);
  }
  else if ((menu==0)&&(item== "pong" )&&(alarmaSonando==false)){
    // ACA HAY QUE PONER EL PONG
    pong();
  }
  else if ((menu==0)&&(item== "GIF" )&&(alarmaSonando==false)){
    // ACA HAY QUE PROGRAMAR EL GIF
    GIF();
  }
  else if ((menu==0)&&(item=="reloj")&&(alarmaSonando==false)){
  reloj();
  }
  else if ((menu==0)&&(item=="alarma")&&(alarmaSonando==false)){
  alarma();
  }
  else if ((menu==0)&&(alarmaSonando==true)){
  alarmaactiva();
  }
}

//////////////////////////////////////////////////////////////////////////////////////////
